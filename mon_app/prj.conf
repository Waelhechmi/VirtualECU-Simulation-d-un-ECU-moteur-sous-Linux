## CMakeLists.txt
```
cmake_minimum_required(VERSION 3.20.0)
find_package(Zephyr REQUIRED HINTS $ENV{ZEPHYR_BASE})
project(mon_app)

target_sources(app PRIVATE 
    src/main.c
    src/engine.c
    src/sensors.c
    src/actuators.c
    src/can_comm.c
)

target_include_directories(app PRIVATE src)
```

## prj.conf
```kconfig
# Configuration minimaliste garantie
CONFIG_MAIN_STACK_SIZE=4096
CONFIG_MULTITHREADING=y
CONFIG_PRINTK=y
CONFIG_STDOUT_CONSOLE=y
CONFIG_HEAP_MEM_POOL_SIZE=4096
```

## src/main.c
```c
#include <zephyr/kernel.h>
#include <zephyr/sys/printk.h>
#include "engine.h"
#include "sensors.h"
#include "actuators.h"
#include "can_comm.h"

int main(void)
{
    struct engine_data_s data;
    int counter = 0;
    
    printk("*** ECU VIRTUEL AVEC MODULES ***\n");
    
    // Initialisation des modules
    engine_init();
    sensors_init();
    actuators_init();
    can_comm_init();
    
    printk("Tous les modules sont initialises\n");
    
    while (1) {
        counter++;
        
        // Lecture des capteurs
        data.rpm = read_rpm();
        data.temperature = read_temperature();
        data.map_pressure = read_map_pressure();
        
        // Traitement ECU
        ecu_processing(&data);
        
        // Contrôle actionneurs
        control_injectors(data.injection_time);
        control_ignition(data.ignition_angle);
        
        // Communication CAN
        send_engine_data(&data);
        process_can_messages();
        
        // Affichage statut
        if (counter % 5 == 0) {
            printk("STATUT: RPM=%d, TEMP=%dC, MAP=%d, INJ=%dms, IGN=%ddeg\n",
                   data.rpm, data.temperature, data.map_pressure,
                   data.injection_time, data.ignition_angle);
        }
        
        k_msleep(500);
    }
    
    return 0;
}
```

## src/actuators.c
```c
#include "actuators.h"
#include <zephyr/sys/printk.h>

void actuators_init(void) {
    printk("Actuators module initialized\n");
}

void control_injectors(int time) {
    // Simulation actionneurs
}

void control_ignition(int angle) {
    // Simulation actionneurs
}
```

## src/actuators.h
```c
#ifndef ACTUATORS_H
#define ACTUATORS_H

void actuators_init(void);
void control_injectors(int time);
void control_ignition(int angle);

#endif
```

## src/can_comm.c
```c
#include "can_comm.h"
#include <zephyr/sys/printk.h>

static int message_count = 0;

void can_comm_init(void) {
    printk("CAN communication initialized\n");
}

void send_engine_data(struct engine_data_s *data) {
    message_count++;
    if (message_count % 20 == 0) {
        printk("CAN: Sent data - RPM:%d, TEMP:%d\n", data->rpm, data->temperature);
    }
}

void process_can_messages(void) {
    // Simulation réception CAN
}
```

## src/can_comm.h
```c
#ifndef CAN_COMM_H
#define CAN_COMM_H

#include "engine.h"

void can_comm_init(void);
void send_engine_data(struct engine_data_s *data);
void process_can_messages(void);

#endif
```

## src/engine.c
```c
#include "engine.h"
#include <zephyr/sys/printk.h>

static struct engine_data_s current_data;

void engine_init(void) {
    current_data.rpm = 800;
    current_data.temperature = 85;
    current_data.map_pressure = 100;
    printk("Engine module initialized\n");
}

void ecu_processing(struct engine_data_s *data) {
    // Logique simple
    data->injection_time = 25 + data->rpm / 100;
    data->ignition_angle = 10 + data->rpm / 200;
    
    if (data->rpm > 4500) {
        printk("ALERTE: RPM eleve: %d\n", data->rpm);
    }
    if (data->temperature > 105) {
        printk("ALERTE: Temperature elevee: %dC\n", data->temperature);
    }
    
    current_data = *data;
}

int get_current_rpm(void) { return current_data.rpm; }
int get_current_temperature(void) { return current_data.temperature; }
```

## src/engine.h
```c
#ifndef ENGINE_H
#define ENGINE_H

// Structure de données
struct engine_data_s {
    int rpm;
    int temperature;
    int map_pressure;
    int injection_time;
    int ignition_angle;
};

// Fonctions
void engine_init(void);
void ecu_processing(struct engine_data_s *data);
int get_current_rpm(void);
int get_current_temperature(void);

#endif
```

## src/sensors.c
```c
#include "sensors.h"
#include <zephyr/kernel.h>

static int counter = 0;

void sensors_init(void) {
    printk("Sensors module initialized\n");
}

int read_rpm(void) {
    counter++;
    int rpm = 800 + (counter % 80) * 60;
    if (rpm > 5000) rpm = 800;
    return rpm;
}

int read_temperature(void) {
    int temp = 80 + (counter % 40) * 2;
    if (temp > 120) temp = 80;
    return temp;
}

int read_map_pressure(void) {
    return 90 + (counter % 30);
}
```

## src/sensors.h
```c
#ifndef SENSORS_H
#define SENSORS_H

void sensors_init(void);
int read_rpm(void);
int read_temperature(void);
int read_map_pressure(void);

#endif
```
