## config.in
```kconfig
config BR2_PACKAGE_VIRTUALECU
    bool "Virtual ECU simulator"
    help
      Software simulation of an engine ECU with virtual sensors and actuators.
```

## mon_app/build/Kconfig/arch/Kconfig
```kconfig
# Load Zephyr Arch Kconfig descriptions.
osource "/home/wael/zephyrproject/zephyr/arch/rx/Kconfig"
osource "/home/wael/zephyrproject/zephyr/arch/x86/Kconfig"
osource "/home/wael/zephyrproject/zephyr/arch/xtensa/Kconfig"
osource "/home/wael/zephyrproject/zephyr/arch/sparc/Kconfig"
osource "/home/wael/zephyrproject/zephyr/arch/riscv/Kconfig"
osource "/home/wael/zephyrproject/zephyr/arch/posix/Kconfig"
osource "/home/wael/zephyrproject/zephyr/arch/mips/Kconfig"
osource "/home/wael/zephyrproject/zephyr/arch/arm64/Kconfig"
osource "/home/wael/zephyrproject/zephyr/arch/arm/Kconfig"
osource "/home/wael/zephyrproject/zephyr/arch/arc/Kconfig"
```

## mon_app/build/Kconfig/boards/Kconfig.defconfig
```kconfig
# Load Zephyr board defconfig descriptions.
osource "/home/wael/zephyrproject/zephyr/boards/qemu/cortex_m3/Kconfig.defconfig"
```

## mon_app/build/Kconfig/boards/Kconfig.qemu_cortex_m3
```kconfig
# Load board Kconfig descriptions.
osource "/home/wael/zephyrproject/zephyr/boards/qemu/cortex_m3/Kconfig.qemu_cortex_m3"
```

## mon_app/build/Kconfig/boards/Kconfig.sysbuild
```kconfig
# Load Sysbuild board Kconfig descriptions.
osource "/home/wael/zephyrproject/zephyr/boards/qemu/cortex_m3/Kconfig.sysbuild"
```
